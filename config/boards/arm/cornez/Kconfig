## config/boards/arm/cornez/Kconfig
```kconfig
config BOARD_ENABLE_DCDC
	bool "Enable DCDC mode"
	select SOC_DCDC_NRF52X
	default y
	depends on (BOARD_CORNEZ_LEFT || BOARD_CORNEZ_RIGHT)
```

## config/boards/arm/cornez/Kconfig.board
```kconfig
config BOARD_CORNEZ_LEFT
	bool "cornez_left"
	depends on SOC_NRF52840_QIAA

config BOARD_CORNEZ_RIGHT
	bool "cornez_right"
	depends on SOC_NRF52840_QIAA
```

## config/boards/arm/cornez/Kconfig.defconfig
```kconfig
if BOARD_CORNEZ_LEFT

	config ZMK_KEYBOARD_NAME
	default "CorNeZ"

	config ZMK_SPLIT_BLE_ROLE_CENTRAL
    default y

	config ZMK_USB
	default y

endif # BOARD_CORNEZ_LEFT

if BOARD_CORNEZ_RIGHT

	config ZMK_KEYBOARD_NAME
	default "CorNeZ right"

endif # BOARD_CORNEZ_RIGHT

if BOARD_CORNEZ_LEFT || BOARD_CORNEZ_RIGHT

	config BOARD
		default "CorNeZ"

	config ZMK_SPLIT
		default y

if ZMK_BACKLIGHT

       config PWM
         default y

       config LED_PWM
         default y

endif # ZMK_BACKLIGHT

if ZMK_RGB_UNDERGLOW

	 config SPI
    	 default y

	 config WS2812_STRIP
    	 default y

endif # ZMK_RGB_UNDERGLOW

if USB_DEVICE_STACK

		config USB_NRFX
			default y

	endif # USB_DEVICE_STACK

	config BT_CTLR
	default BT

	config ZMK_BLE
		default y

	config ZMK_DISPLAY
		select LV_USE_CONT
		select LV_FONT_MONTSERRAT_26
		select LV_FONT_MONTSERRAT_20
		select LV_FONT_MONTSERRAT_16
		select LV_USE_LABEL
		select LV_USE_IMG

	if ZMK_DISPLAY

		config SYSTEM_WORKQUEUE_STACK_SIZE
			default 2048

		choice LV_FONT_DEFAULT
			default LV_FONT_DEFAULT_MONTSERRAT_26
		endchoice

		choice ZMK_LV_FONT_DEFAULT_SMALL
			default ZMK_LV_FONT_DEFAULT_SMALL_MONTSERRAT_26
		endchoice

		config LV_HOR_RES_MAX
			int "Max horizontal resolution"
			default 128

		config LV_VER_RES_MAX
			int "Max vertical resolution"
			default 32

		config I2C
            default y

        config SSD1306
            default y

		config LV_Z_BITS_PER_PIXEL
			default 1

		choice LV_COLOR_DEPTH
			default LV_COLOR_DEPTH_1
		endchoice

		config LV_DPI_DEF
			default 148

		config LV_Z_VDB_SIZE
			default 64

		choice ZMK_DISPLAY_STATUS_SCREEN
			default ZMK_DISPLAY_STATUS_SCREEN_CUSTOM
		endchoice

	endif # ZMK_DISPLAY

	menuconfig CUSTOM_WIDGET_BATTERY_STATUS
		bool "custom battery status widget"

	menuconfig CUSTOM_WIDGET_OUTPUT_STATUS
		bool "custom output status widget"
		depends on !ZMK_SPLIT || ZMK_SPLIT_ROLE_CENTRAL

	menuconfig CUSTOM_WIDGET_PERIPHERAL_STATUS
		bool "custom peripheral status widget"
		depends on ZMK_SPLIT && !ZMK_SPLIT_ROLE_CENTRAL

	menuconfig CUSTOM_WIDGET_PROFILE_STATUS
		bool "custom profile status widget"
		depends on !ZMK_SPLIT || ZMK_SPLIT_ROLE_CENTRAL

	menuconfig CUSTOM_WIDGET_LAYER_STATUS
		bool "custom layer status widget"
		depends on !ZMK_SPLIT || ZMK_SPLIT_ROLE_CENTRAL

	menuconfig CUSTOM_WIDGET_PET_STATUS
		bool "custom pet status widget"
		depends on !ZMK_SPLIT || ZMK_SPLIT_ROLE_CENTRAL
		select LV_USE_IMG
		select LV_USE_ANIMATION
		select ZMK_WPM

	if CUSTOM_WIDGET_PET_STATUS

		config CUSTOM_WIDGET_PET_WALK_WPM
			int "Lower WPM limit for pet to start walking"
			default 10

		config CUSTOM_WIDGET_PET_RUN_WPM
			int "Lower WPM limit for pet to start running"
			default 50
		
	endif # CUSTOM_WIDGET_PET_STATUS

endif # BOARD_CORNEZ_LEFT || BOARD_CORNEZ_RIGHT
```
